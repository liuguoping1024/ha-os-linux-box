## buildroot-external/package/amlogic-boot-fip-legacy/Config.in
```kconfig
config BR2_PACKAGE_AMLOGIC_BOOT_FIP_LEGACY
	bool "amlogic-boot-fip-legacy"
	help
	  Provides prebuilt Amlogic bootloader images built with the
	  legacy SDK (U-Boot 2015.01 + old FIP toolchain).

	  This is required for boards that need BL2 ACS DDR parameter
	  passing (e.g. dual-chip DDR configurations) which is not
	  supported by modern amlogic-boot-fip.

if BR2_PACKAGE_AMLOGIC_BOOT_FIP_LEGACY

config BR2_PACKAGE_AMLOGIC_BOOT_FIP_LEGACY_BOARD
	string "Board name for legacy FIP"
	depends on BR2_PACKAGE_AMLOGIC_BOOT_FIP_LEGACY
	help
	  Name of the board subdirectory under
	  board/thirdreality/<board>/fip/ containing the prebuilt
	  u-boot.bin.sd.bin.

endif
```

## buildroot-external/package/hubv3-bridge/Config.in
```kconfig
config BR2_PACKAGE_HUBV3_BRIDGE
	bool "hubv3-bridge"
	depends on !BR2_STATIC_LIBS
	select BR2_PACKAGE_LIBWEBSOCKETS
	select BR2_PACKAGE_OPENSSL
	select BR2_PACKAGE_LIBCURL
	select BR2_PACKAGE_LIBYAML
	select BR2_PACKAGE_CJSON
	select BR2_PACKAGE_MOSQUITTO
	select BR2_PACKAGE_DBUS
	select BR2_PACKAGE_JQ
	help
	  LinuxBox HubV3 Bridge - IoT Device Integration Service.
	  A C-based bridge daemon that connects Zigbee2MQTT, Home Assistant,
	  and ThirdReality cloud via MQTT/WebSocket, providing device state
	  synchronization, remote command execution, and OTA update support.

	  https://github.com/liuguoping1024/hubv3_service

comment "hubv3-bridge needs a toolchain w/ dynamic library"
	depends on BR2_STATIC_LIBS
```

## buildroot-external/package/hubv3-supervisor/Config.in
```kconfig
config BR2_PACKAGE_HUBV3_SUPERVISOR
	bool "hubv3-supervisor"
	depends on BR2_PACKAGE_BLUEZ5_UTILS
	select BR2_PACKAGE_LIBGLIB2
	select BR2_PACKAGE_JSON_C
	select BR2_PACKAGE_AVAHI
	select BR2_PACKAGE_AVAHI_DAEMON
	select BR2_PACKAGE_LIBGPIOD
	select BR2_PACKAGE_OPENSSL
	select BR2_PACKAGE_LIBMICROHTTPD
	select BR2_PACKAGE_LIBCURL
	select BR2_PACKAGE_LIBYAML
	select BR2_PACKAGE_SQLITE
	select BR2_PACKAGE_CJSON
	help
	  LinuxBox Supervisor for ThirdReality Hub V3.
	  A C-based device management daemon providing hardware control
	  (LED, button, GPIO), network management, HTTP API, D-Bus service,
	  Zigbee/Thread device management, BLE provisioning, OTA upgrade,
	  mDNS broadcast, and Home Assistant integration.

	  https://github.com/liuguoping1024/LinuxBox_Supervisor

comment "hubv3-supervisor needs bluez5_utils"
	depends on !BR2_PACKAGE_BLUEZ5_UTILS
```

## buildroot-external/package/python-bflb-crypto-plus/Config.in
```kconfig
config BR2_PACKAGE_PYTHON_BFLB_CRYPTO_PLUS
	bool "python-bflb-crypto-plus"
	select BR2_PACKAGE_PYTHON_PYCRYPTODOME
	help
	  Bouffalo Lab crypto utilities for firmware tools.

	  https://pypi.org/project/bflb-crypto-plus/
```

## buildroot-external/package/python-portalocker/Config.in
```kconfig
config BR2_PACKAGE_PYTHON_PORTALOCKER
	bool "python-portalocker"
	help
	  Cross-platform (posix/nt) API for flock-style file locking.

	  https://github.com/WoLpH/portalocker
```

## buildroot-external/package/python-pycryptodome/Config.in
```kconfig
config BR2_PACKAGE_PYTHON_PYCRYPTODOME
	bool "python-pycryptodome"
	help
	  PyCryptodome is a self-contained Python package of
	  low-level cryptographic primitives. Installs as 'Crypto'
	  namespace (drop-in replacement for PyCrypto).

	  https://www.pycryptodome.org
```

## buildroot-external/package/python-pyserial/Config.in
```kconfig
config BR2_PACKAGE_PYTHON_PYSERIAL
	bool "python-pyserial"
	help
	  Python serial port access library.

	  https://github.com/pyserial/pyserial
```

## buildroot-external/package/zigbee-herdsman/Config.in
```kconfig
config BR2_PACKAGE_ZIGBEE_HERDSMAN
	bool "zigbee-herdsman"
	depends on BR2_PACKAGE_NODEJS
	help
	  ThirdReality customized Zigbee-herdsman library for BLZ radio type.
	  This is a dependency for zigbee2mqtt.

	  https://github.com/thirdreality/zigbee-herdsman

comment "zigbee-herdsman needs nodejs"
	depends on !BR2_PACKAGE_NODEJS
```

## buildroot-external/package/zigbee2mqtt/Config.in
```kconfig
config BR2_PACKAGE_ZIGBEE2MQTT
	bool "zigbee2mqtt"
	depends on BR2_PACKAGE_NODEJS
	depends on BR2_PACKAGE_MOSQUITTO
	select BR2_PACKAGE_ICU
	select BR2_PACKAGE_ZIGBEE_HERDSMAN
	help
	  ThirdReality customized Zigbee2MQTT for BLZ radio type.
	  Allows you to use your Zigbee devices without the vendor's
	  bridge or gateway. It bridges events and allows you to control
	  your Zigbee devices via MQTT.

	  https://github.com/thirdreality/zigbee2mqtt
	  https://www.zigbee2mqtt.io/

comment "zigbee2mqtt needs nodejs and mosquitto"
	depends on !BR2_PACKAGE_NODEJS || !BR2_PACKAGE_MOSQUITTO
```
